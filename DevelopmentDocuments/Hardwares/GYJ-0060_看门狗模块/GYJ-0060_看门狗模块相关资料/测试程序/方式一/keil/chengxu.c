/********************************************************************
                            汇诚科技
网址：http://www.ourhc.cn
产品有售淘宝店：http://shop36330473.taobao.com   
*********************************************************************/
#include<reg52.h>  	       //库文件
#define uchar unsigned char//宏定义无符号字符型
#define uint unsigned int  //宏定义无符号整型
/********************************************************************
                            I/O定义
*********************************************************************/
sbit LED=P1^0;	 //定义单片机P1口的第0位 （即P1.0）
sbit P20=P2^0;
sbit P21=P2^1;
sbit P22=P2^2;
sbit P23=P2^3;
sbit P24=P2^4;
/********************************************************************
                            延时函数
*********************************************************************/
void delay()//延时程序
{
uchar m,n,s;
for(m=2;m>0;m--)
for(n=20;n>0;n--)
for(s=248;s>0;s--);
}
/********************************************************************
                            主函数
*********************************************************************/
void main()
{
	while(1)   //无限循环
	{
	P0=0X00;	   //点亮P1.0口灯
	 delay();  //延时
	P0=0XFF;	   //熄灭P1.0口灯
	 delay();  //延时
   if(P20==0){delay();while(!P20);}
      if(P21==0){delay();while(!P21);}
	     if(P22==0){delay();while(!P22);}
		    if(P23==0){delay();while(!P23);}
			   if(P24==0){delay();while(!P24);}
	}
}	
/********************************************************************
                              结束
*********************************************************************/